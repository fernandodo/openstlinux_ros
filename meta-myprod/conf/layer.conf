## meta-myprod/conf/layer.conf
```bitbake
# We have a conf and classes directory, add to BBPATH
BBPATH .= ":${LAYERDIR}"

# We have recipes-* directories, add to BBFILES
BBFILES += "${LAYERDIR}/recipes-*/*/*.bb \
            ${LAYERDIR}/recipes-*/*/*.bbappend"

BBFILE_COLLECTIONS += "meta-myprod"
BBFILE_PATTERN_meta-myprod = "^${LAYERDIR}/"
BBFILE_PRIORITY_meta-myprod = "6"

LAYERDEPENDS_meta-myprod = "core"
LAYERSERIES_COMPAT_meta-myprod = "scarthgap"
```
